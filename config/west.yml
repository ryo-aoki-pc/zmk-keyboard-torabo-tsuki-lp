## config/west.yml
```yaml
manifest:
  remotes:
    - name: zmkfirmware
      url-base: https://github.com/zmkfirmware
    - name: sekigon-gonnoc
      url-base: https://github.com/sekigon-gonnoc
    - name: ryo-aoki-pc
      url-base: https://github.com/ryo-aoki-pc
  projects:
    - name: zmk
      remote: zmkfirmware
      revision: v0.3.0
      import: app/west.yml
    - name: zmk-component-bmp-boost
      remote: sekigon-gonnoc
      import: west.yml
      revision: v0.2
    - name: zmk-feature-status-led
      remote: sekigon-gonnoc
      revision: main
    - name: zmk-driver-paw3222
      remote: sekigon-gonnoc
      revision: torabo-tsuki
    - name: zmk-driver-iqs7211e
      remote: sekigon-gonnoc
    - name: zmk-feature-cdc-acm-bootloader-trigger
      remote: sekigon-gonnoc
      revision: v0.2
    - name: zmk-feature-non-lipo-battery-management
      remote: sekigon-gonnoc
      revision: main
    # トラックボールの速さに応じてカーソルに倍率を掛ける入力プロセッサ (torabo_tsuki_lp.dtsi の trackball_accel)
    - name: zmk-input-processor-xy-accel
      remote: ryo-aoki-pc
      revision: a5233f76a88b369dfebc37371f8244c89df2d0d4
  self:
    path: config
```
