#include "torabo_tsuki_lp.dtsi"
#include <input/processors.dtsi>
#include <dt-bindings/zmk/input_transform.h>

// 左手側にトラックボールを付けて左をセントラルにするとき (build.yaml の「Central = Left」) 用。
// AML とスクロールは右手側 (torabo_tsuki_lp_right.overlay) と同じ。
&pointing_listener {
    input-processors =
        <&zip_xy_transform (INPUT_TRANSFORM_X_INVERT | INPUT_TRANSFORM_Y_INVERT)>,
        <&zip_xy_scaler 1 1>,
        <&trackball_accel>,             // 速さに応じた倍率 (カーソルの加速)
        <&zip_temp_layer 8 10000>;

    scroller {
        layers = <9>;
        input-processors =
            <&zip_xy_to_scroll_mapper>,
            <&zip_scroll_transform (INPUT_TRANSFORM_X_INVERT)>,
            <&zip_scroll_scaler 1 1>;
    };
};

// Q を押したまま USB ケーブルを挿すと、ブートローダになる (src/usb_bootmagic.c)
/ {
    usb_bootmagic {
        compatible = "zmk,usb-bootmagic";
        row = <1>;
        column = <1>;
    };
};
